## base/build/Kconfig/Kconfig.modules
```kconfig
menu "firmware (/home/bergm/csse4011/firmware)"
osource "/home/bergm/csse4011/firmware/Kconfig"
config ZEPHYR_FIRMWARE_MODULE
	bool
	default y
endmenu
menu "csse4011-sdk (/home/bergm/csse4011/csse4011-sdk)"
osource "/home/bergm/csse4011/csse4011-sdk/Kconfig"
config ZEPHYR_CSSE4011_SDK_MODULE
	bool
	default y
endmenu
menu "zscilib (/home/bergm/csse4011/modules/lib/zscilib)"
osource "/home/bergm/csse4011/modules/lib/zscilib/Kconfig.zscilib"
config ZEPHYR_ZSCILIB_MODULE
	bool
	default y
endmenu
menu "cmsis (/home/bergm/csse4011/modules/hal/cmsis)"
osource "$(ZEPHYR_CMSIS_KCONFIG)"
config ZEPHYR_CMSIS_MODULE
	bool
	default y
endmenu
menu "cmsis-dsp (/home/bergm/csse4011/modules/lib/cmsis-dsp)"
osource "$(ZEPHYR_CMSIS_DSP_KCONFIG)"
config ZEPHYR_CMSIS_DSP_MODULE
	bool
	default y
endmenu
menu "cmsis-nn (/home/bergm/csse4011/modules/lib/cmsis-nn)"
osource "$(ZEPHYR_CMSIS_NN_KCONFIG)"
config ZEPHYR_CMSIS_NN_MODULE
	bool
	default y
endmenu
menu "cmsis_6 (/home/bergm/csse4011/modules/hal/cmsis_6)"
osource "$(ZEPHYR_CMSIS_6_KCONFIG)"
config ZEPHYR_CMSIS_6_MODULE
	bool
	default y
endmenu
menu "fatfs (/home/bergm/csse4011/modules/fs/fatfs)"
osource "$(ZEPHYR_FATFS_KCONFIG)"
config ZEPHYR_FATFS_MODULE
	bool
	default y
endmenu
menu "hal_nordic (/home/bergm/csse4011/modules/hal/nordic)"
osource "$(ZEPHYR_HAL_NORDIC_KCONFIG)"
config ZEPHYR_HAL_NORDIC_MODULE
	bool
	default y

config ZEPHYR_HAL_NORDIC_MODULE_BLOBS
	bool
endmenu
menu "hal_rpi_pico (/home/bergm/csse4011/modules/hal/rpi_pico)"
osource "$(ZEPHYR_HAL_RPI_PICO_KCONFIG)"
config ZEPHYR_HAL_RPI_PICO_MODULE
	bool
	default y
endmenu
menu "hal_st (/home/bergm/csse4011/modules/hal/st)"
osource "$(ZEPHYR_HAL_ST_KCONFIG)"
config ZEPHYR_HAL_ST_MODULE
	bool
	default y
endmenu
config ZEPHYR_HAL_STM32_MODULE
	bool
	default y

config ZEPHYR_HAL_STM32_MODULE_BLOBS
	bool
menu "hal_tdk (/home/bergm/csse4011/modules/hal/tdk)"
osource "$(ZEPHYR_HAL_TDK_KCONFIG)"
config ZEPHYR_HAL_TDK_MODULE
	bool
	default y
endmenu
config ZEPHYR_HAL_WURTHELEKTRONIK_MODULE
	bool
	default y
menu "hostap (/home/bergm/csse4011/modules/lib/hostap)"
osource "$(ZEPHYR_HOSTAP_KCONFIG)"
config ZEPHYR_HOSTAP_MODULE
	bool
	default y
endmenu
menu "liblc3 (/home/bergm/csse4011/modules/lib/liblc3)"
osource "$(ZEPHYR_LIBLC3_KCONFIG)"
config ZEPHYR_LIBLC3_MODULE
	bool
	default y
endmenu
config ZEPHYR_LIBMETAL_MODULE
	bool
	default y
menu "littlefs (/home/bergm/csse4011/modules/fs/littlefs)"
osource "$(ZEPHYR_LITTLEFS_KCONFIG)"
config ZEPHYR_LITTLEFS_MODULE
	bool
	default y
endmenu
menu "loramac-node (/home/bergm/csse4011/modules/lib/loramac-node)"
osource "$(ZEPHYR_LORAMAC_NODE_KCONFIG)"
config ZEPHYR_LORAMAC_NODE_MODULE
	bool
	default y
endmenu
menu "lvgl (/home/bergm/csse4011/modules/lib/gui/lvgl)"
osource "/home/bergm/csse4011/modules/lib/gui/lvgl/zephyr/Kconfig"
config ZEPHYR_LVGL_MODULE
	bool
	default y
endmenu
menu "mbedtls (/home/bergm/csse4011/modules/crypto/mbedtls)"
osource "$(ZEPHYR_MBEDTLS_KCONFIG)"
config ZEPHYR_MBEDTLS_MODULE
	bool
	default y
endmenu
config ZEPHYR_MIPI_SYS_T_MODULE
	bool
	default y
menu "nanopb (/home/bergm/csse4011/modules/lib/nanopb)"
osource "$(ZEPHYR_NANOPB_KCONFIG)"
config ZEPHYR_NANOPB_MODULE
	bool
	default y
endmenu
menu "nrf_wifi (/home/bergm/csse4011/modules/lib/nrf_wifi)"
osource "$(ZEPHYR_NRF_WIFI_KCONFIG)"
config ZEPHYR_NRF_WIFI_MODULE
	bool
	default y

config ZEPHYR_NRF_WIFI_MODULE_BLOBS
	bool
endmenu
config ZEPHYR_OPEN_AMP_MODULE
	bool
	default y
menu "percepio (/home/bergm/csse4011/modules/debug/percepio)"
osource "/home/bergm/csse4011/modules/debug/percepio/zephyr/Kconfig"
config ZEPHYR_PERCEPIO_MODULE
	bool
	default y
endmenu
menu "picolibc (/home/bergm/csse4011/modules/lib/picolibc)"
osource "/home/bergm/csse4011/modules/lib/picolibc/zephyr/Kconfig"
config ZEPHYR_PICOLIBC_MODULE
	bool
	default y
endmenu
menu "segger (/home/bergm/csse4011/modules/debug/segger)"
osource "$(ZEPHYR_SEGGER_KCONFIG)"
config ZEPHYR_SEGGER_MODULE
	bool
	default y
endmenu
menu "uoscore-uedhoc (/home/bergm/csse4011/modules/lib/uoscore-uedhoc)"
osource "$(ZEPHYR_UOSCORE_UEDHOC_KCONFIG)"
config ZEPHYR_UOSCORE_UEDHOC_MODULE
	bool
	default y
endmenu
menu "zcbor (/home/bergm/csse4011/modules/lib/zcbor)"
osource "$(ZEPHYR_ZCBOR_KCONFIG)"
config ZEPHYR_ZCBOR_MODULE
	bool
	default y
endmenu
config ZEPHYR_NRF_HW_MODELS_MODULE
	bool
	default y
```

## base/build/Kconfig/boards/Kconfig
```kconfig
# Load Zephyr board Kconfig descriptions.
osource "/home/bergm/csse4011/zephyr/boards/seeed/xiao_ble/Kconfig"
```

## base/build/Kconfig/boards/Kconfig.sysbuild
```kconfig
# Load Sysbuild board Kconfig descriptions.
osource "/home/bergm/csse4011/zephyr/boards/seeed/xiao_ble/Kconfig.sysbuild"
```

## base/build/Kconfig/boards/Kconfig.xiao_ble
```kconfig
# Load board Kconfig descriptions.
osource "/home/bergm/csse4011/zephyr/boards/seeed/xiao_ble/Kconfig.xiao_ble"
```

## camera/build/Kconfig/arch/Kconfig
```kconfig
# Load Zephyr Arch Kconfig descriptions.
osource "/home/bergm/csse4011/zephyr/arch/rx/Kconfig"
osource "/home/bergm/csse4011/zephyr/arch/x86/Kconfig"
osource "/home/bergm/csse4011/zephyr/arch/xtensa/Kconfig"
osource "/home/bergm/csse4011/zephyr/arch/sparc/Kconfig"
osource "/home/bergm/csse4011/zephyr/arch/riscv/Kconfig"
osource "/home/bergm/csse4011/zephyr/arch/posix/Kconfig"
osource "/home/bergm/csse4011/zephyr/arch/mips/Kconfig"
osource "/home/bergm/csse4011/zephyr/arch/arm64/Kconfig"
osource "/home/bergm/csse4011/zephyr/arch/arm/Kconfig"
osource "/home/bergm/csse4011/zephyr/arch/arc/Kconfig"
```

## camera/build/Kconfig/boards/Kconfig.defconfig
```kconfig
# Load Zephyr board defconfig descriptions.
osource "/home/bergm/csse4011/zephyr/boards/seeed/xiao_ble/Kconfig.defconfig"
```
