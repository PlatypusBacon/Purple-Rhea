## prj.conf
```kconfig
CONFIG_STDOUT_CONSOLE=y
CONFIG_SHELL=y
CONFIG_SHELL_BACKEND_SERIAL=y
CONFIG_UART_CONSOLE=y
CONFIG_SERIAL=y
CONFIG_GPIO=y
```

## inc/processing_thread.h
```c
#ifndef PROCESSING_THREAD_H
#define PROCESSING_THREAD_H
#include <stdbool.h>
#include <zephyr/kernel.h>

void processing_thread_entry(void *p1, void *p2, void *p3);
#endif
```

## src/processing_thread.c
```c
#include <stdio.h>
#include "processing_thread.h"

void processing_thread_entry(void *p1, void *p2, void *p3)
{
    ARG_UNUSED(p1); ARG_UNUSED(p2); ARG_UNUSED(p3);
    printk("Processing thread started\n");

    while (true) {
        k_sleep(K_SECONDS(1));
    }
}
```
